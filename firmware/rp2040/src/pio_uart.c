/**
 * SAINT.OS Node Firmware - PIO UART
 *
 * Implementation notes:
 *
 *  - Two PIO state machines run autonomously after pio_uart_init().
 *    The TX SM stalls on its TX FIFO when there's nothing to send
 *    (drives the line HIGH for idle). The RX SM stalls on its `wait
 *    0 pin 0` when the line is idle HIGH, springs into sampling when
 *    it sees the start bit, and pushes the assembled byte into the
 *    RX FIFO.
 *
 *  - The C side is a thin dispatch on top of pio_sm_get / pio_sm_put.
 *    No interrupts — the FIFOs are deep enough (8 TX, 16 RX with join)
 *    that the main loop polling at ~100 Hz never loses a byte at
 *    38400 baud (~3840 bytes/s, ~38 bytes per main-loop iteration —
 *    bigger than the FIFO, but RoboClaw responses are 4–8 bytes per
 *    request so we never get more than one response in flight).
 *
 *  - We claim two SMs on a single PIO block. PIO0 sm0 is taken by
 *    the NeoPixel; default to PIO1 to avoid any contention even if a
 *    future change uses more of PIO0. Pass a different block to
 *    pio_uart_init() if you need to share a block with other
 *    programs.
 */

#include "pio_uart.h"

#ifndef SIMULATION

#include <string.h>
#include <stdio.h>

#include "pico/stdlib.h"
#include "hardware/pio.h"
#include "hardware/clocks.h"

#include "pio_uart.pio.h"   // generated from pio_uart.pio at build time

// =============================================================================
// Internal state
// =============================================================================

static PIO   bound_pio    = NULL;
static uint  bound_sm_tx  = 0;
static uint  bound_sm_rx  = 0;
static uint  tx_offset    = 0;
static uint  rx_offset    = 0;
static uint  bound_tx_pin = 0xFF;
static uint  bound_rx_pin = 0xFF;
static uint  bound_baud   = 0;
static bool  active       = false;

// =============================================================================
// Public API
// =============================================================================

bool pio_uart_init(PIO pio_block, uint tx_pin, uint rx_pin, uint baud_rate)
{
    if (!pio_block) return false;

    // Idempotent fast path: same args, already bound.
    if (active
        && bound_pio == pio_block
        && bound_tx_pin == tx_pin
        && bound_rx_pin == rx_pin
        && bound_baud == baud_rate) {
        return true;
    }

    // Different args (or bound to a different block): release first.
    if (active) {
        pio_uart_deinit();
    }

    // Both programs live in the same PIO block; pio_add_program returns
    // the program's start offset (in PIO instruction slots) and reserves
    // the slots. Failure (-1) means the block doesn't have enough free
    // contiguous instruction space — fall through cleanly so the caller
    // can fall back to the hardware UART path.
    if (!pio_can_add_program(pio_block, &pio_uart_tx_program)) {
        printf("pio_uart: PIO%d has no room for TX program\n",
               (pio_block == pio0) ? 0 : 1);
        return false;
    }
    tx_offset = pio_add_program(pio_block, &pio_uart_tx_program);

    if (!pio_can_add_program(pio_block, &pio_uart_rx_program)) {
        printf("pio_uart: PIO%d has no room for RX program\n",
               (pio_block == pio0) ? 0 : 1);
        pio_remove_program(pio_block, &pio_uart_tx_program, tx_offset);
        return false;
    }
    rx_offset = pio_add_program(pio_block, &pio_uart_rx_program);

    // Claim two state machines on this block. pio_claim_unused_sm
    // returns -1 if none free; with the NeoPixel taking 1 SM on PIO0
    // and this taking 2 SMs on (typically) PIO1, headroom is fine.
    int sm_tx_n = pio_claim_unused_sm(pio_block, false);
    if (sm_tx_n < 0) {
        printf("pio_uart: no free SM for TX on PIO%d\n",
               (pio_block == pio0) ? 0 : 1);
        pio_remove_program(pio_block, &pio_uart_rx_program, rx_offset);
        pio_remove_program(pio_block, &pio_uart_tx_program, tx_offset);
        return false;
    }
    int sm_rx_n = pio_claim_unused_sm(pio_block, false);
    if (sm_rx_n < 0) {
        printf("pio_uart: no free SM for RX on PIO%d\n",
               (pio_block == pio0) ? 0 : 1);
        pio_sm_unclaim(pio_block, (uint)sm_tx_n);
        pio_remove_program(pio_block, &pio_uart_rx_program, rx_offset);
        pio_remove_program(pio_block, &pio_uart_tx_program, tx_offset);
        return false;
    }

    bound_pio    = pio_block;
    bound_sm_tx  = (uint)sm_tx_n;
    bound_sm_rx  = (uint)sm_rx_n;
    bound_tx_pin = tx_pin;
    bound_rx_pin = rx_pin;
    bound_baud   = baud_rate;

    // Hand off to the init helpers generated by the .pio c-sdk blocks.
    pio_uart_tx_program_init(bound_pio, bound_sm_tx, tx_offset, tx_pin, baud_rate);
    pio_uart_rx_program_init(bound_pio, bound_sm_rx, rx_offset, rx_pin, baud_rate);

    active = true;
    printf("pio_uart: bound on PIO%d (TX=SM%u GP%u, RX=SM%u GP%u) @ %u baud\n",
           (bound_pio == pio0) ? 0 : 1,
           bound_sm_tx, tx_pin, bound_sm_rx, rx_pin, baud_rate);
    return true;
}

void pio_uart_deinit(void)
{
    if (!active) return;

    pio_sm_set_enabled(bound_pio, bound_sm_tx, false);
    pio_sm_set_enabled(bound_pio, bound_sm_rx, false);
    pio_sm_unclaim(bound_pio, bound_sm_tx);
    pio_sm_unclaim(bound_pio, bound_sm_rx);
    pio_remove_program(bound_pio, &pio_uart_rx_program, rx_offset);
    pio_remove_program(bound_pio, &pio_uart_tx_program, tx_offset);

    // Return the pins to SIO inputs (high-Z) so a future re-bind on
    // different pins doesn't get crosstalk from stale GPIO function
    // selection.
    gpio_set_function(bound_tx_pin, GPIO_FUNC_SIO);
    gpio_set_dir(bound_tx_pin, GPIO_IN);
    gpio_set_function(bound_rx_pin, GPIO_FUNC_SIO);
    gpio_set_dir(bound_rx_pin, GPIO_IN);

    active = false;
    bound_pio = NULL;
}

bool pio_uart_is_active(void)
{
    return active;
}

void pio_uart_write_blocking(const uint8_t* src, size_t len)
{
    if (!active || !src) return;
    for (size_t i = 0; i < len; i++) {
        // pio_sm_put_blocking stalls when the TX FIFO is full —
        // matches uart_write_blocking semantics.
        pio_sm_put_blocking(bound_pio, bound_sm_tx, (uint32_t)src[i]);
    }
}

void pio_uart_tx_wait_blocking(void)
{
    if (!active) return;
    // Drain the FIFO first.
    while (!pio_sm_is_tx_fifo_empty(bound_pio, bound_sm_tx)) {
        tight_loop_contents();
    }
    // Then wait for the SM to finish shifting the last byte. The TX
    // program parks on `pull side 1 [7]` when there's no work — the
    // SM is "idle" at that PC. We wait for the SM's stalled flag.
    // (PL011's analog of "tx_idle" — close enough for our needs.)
    // Sleep a single byte-time as a safety margin: at 38400 baud,
    // one byte is ~260 µs; sleeping 1 ms covers any baud >= ~10000.
    sleep_us(300);
}

bool pio_uart_is_readable(void)
{
    if (!active) return false;
    return !pio_sm_is_rx_fifo_empty(bound_pio, bound_sm_rx);
}

uint8_t pio_uart_getc(void)
{
    if (!active) return 0;
    // The RX program shifts right; after 8 bits the byte sits in the
    // high 8 bits of the 32-bit FIFO word, with LSB at bit 24 and MSB
    // at bit 31. Shift right by 24 to extract.
    uint32_t raw = pio_sm_get_blocking(bound_pio, bound_sm_rx);
    return (uint8_t)(raw >> 24);
}

#else  // SIMULATION

// Host-runnable stubs so the driver compiles in unit tests.

bool pio_uart_init(void* pio_block, unsigned tx_pin, unsigned rx_pin,
                   unsigned baud_rate)
{
    (void)pio_block; (void)tx_pin; (void)rx_pin; (void)baud_rate;
    return false;  // no PIO in simulation; caller must fall back to HW UART
}

void pio_uart_deinit(void) {}

bool pio_uart_is_active(void) { return false; }

void pio_uart_write_blocking(const uint8_t* src, size_t len) {
    (void)src; (void)len;
}

void pio_uart_tx_wait_blocking(void) {}

bool pio_uart_is_readable(void) { return false; }

uint8_t pio_uart_getc(void) { return 0; }

#endif  // SIMULATION
